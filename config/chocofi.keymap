/* source key position labels */
#include "zmk-helpers/key-labels/36.h"

#include <behaviors.dtsi>
#include <behaviors/num_word.dtsi> // requires auto-layer module
#include <dt-bindings/zmk/keys.h>

#include "zmk-helpers/helper.h"

#define DEF 0
#define NAV 1
#define FN 2
#define NUM 3
#define SYS 4

#define XXX &none
#define ___ &trans

/* Global settings */

#define QUICK_TAP_MS 175

&sk {  // sticky-key config
    release-after-ms = <900>;  // release after 0.9s
    quick-release;             // no double capitalization when rolling keys
};

&sl {  // sticky-layer config
    ignore-modifiers;          // allow chording sticky mods & layers
};

&lt {  // layer-tap config
    flavor = "balanced";
    tapping-term-ms = <200>;
    quick-tap-ms = <QUICK_TAP_MS>;
};

&leader {  // leader-key config
    timeout-ms = <650>;
};

/* Homerow mods */

#define KEYS_L LT0 LT1 LT2 LT3 LT4 LM0 LM1 LM2 LM3 LM4 LB0 LB1 LB2 LB3 LB4  // left hand
#define KEYS_R RT0 RT1 RT2 RT3 RT4 RM0 RM1 RM2 RM3 RM4 RB0 RB1 RB2 RB3 RB4  // right hand
#define THUMBS LH2 LH1 LH0 RH0 RH1 RH2                                  // thumbs on 36+ keys

#define MAKE_HRM(NAME, HOLD, TAP, TRIGGER_POS) \
    ZMK_HOLD_TAP(NAME, \
        flavor = "balanced"; \
        tapping-term-ms = <280>; \
        quick-tap-ms = <QUICK_TAP_MS>; \
        require-prior-idle-ms = <150>; \
        bindings = <HOLD>, <TAP>; \
        hold-trigger-key-positions = <TRIGGER_POS>; \
        hold-trigger-on-release; \
    )
MAKE_HRM(hml, &kp, &kp, KEYS_R THUMBS)  // left-hand HRMs
MAKE_HRM(hmr, &kp, &kp, KEYS_L THUMBS)  // right-hand HRMs

// HRM combo hack - workaround for lack of tap-only combos (ZMK issue #544)
#define ZMK_COMBO_8(NAME, TAP, KEYPOS, LAYERS, COMBO_TERM, COMBO_IDLE, HOLD, SIDE) \
    MAKE_HRM(hm_combo_ ## NAME, &kp, TAP, SIDE THUMBS) \
    ZMK_COMBO_6(NAME, &hm_combo_ ## NAME HOLD 0, KEYPOS, LAYERS, COMBO_TERM, COMBO_IDLE)

/* Combos, leader key sequences, mouse emulation */

#include "combos.dtsi"  // must be sourced after HRM-combo hack
#include "leader.dtsi"
#include "mouse.dtsi"
#include "extra_keys.h"

/* Nav cluster */

// long-tap action on hold, short-tap action on all interrupts
#define MT_CORE \
    flavor = "tap-preferred"; \
    tapping-term-ms = <220>; \
    quick-tap-ms = <220>; \
    hold-trigger-key-positions = <0>;

&mt { MT_CORE };
ZMK_HOLD_TAP(mt_home, bindings = <&masked_home>, <&kp>; MT_CORE)
ZMK_HOLD_TAP(mt_end, bindings = <&masked_end>, <&kp>; MT_CORE)

#define NAV_BSPC  &mt LC(BSPC) BSPC    // tap: bspc  | long-tap: delete word backward
#define NAV_DEL   &mt LC(DEL)  DEL     // tap: del   | long-tap: delete word forward

/* Custom behaviors */

// Alt+Tab swapper, requires PR #1366
// ZMK_TRI_STATE(swapper,
//     bindings = <&kt LALT>, <&kp TAB>, <&kt LALT>;
//     ignored-key-positions = <LT2>;
// )

// reuse basic mod-morph scheme
#define SIMPLE_MORPH(NAME, MOD, BINDING1, BINDING2) \
    ZMK_MOD_MORPH(NAME, \
        mods = <(MOD_L ## MOD|MOD_R ## MOD)>; \
        bindings = <BINDING1>, <BINDING2>; \
    )

// examples
// tap: comma | shift + tap: semicolon | ctrl + shift + tap: <
// SIMPLE_MORPH(comma_morph, SFT, &kp COMMA, &comma_inner_morph)
// SIMPLE_MORPH(comma_inner_morph, CTL, &kp SEMICOLON, &kp LESS_THAN)

// tap: dot | shift + tap: colon | ctrl + shift + tap: >
// SIMPLE_MORPH(dot_morph, SFT, &kp DOT, &dot_inner_morph)
// SIMPLE_MORPH(dot_inner_morph, CTL, &kp COLON, &kp GREATER_THAN)

// // tap: qmark | shift + tap: excl
// SIMPLE_MORPH(qexcl, SFT, &kp QMARK, &kp EXCL)

// // tap: left/right parenthesis | shft + tap: less-than/greater-than
// SIMPLE_MORPH(lpar_lt, SFT, &kp LPAR, &kp LT)
// SIMPLE_MORPH(rpar_gt, SFT, &kp RPAR, &kp GT)

// // tap: space | shift + tap: dot -> space -> sticky shift | hold: activate layer
// ZMK_HOLD_TAP(lt_spc,
//     flavor = "balanced";
//     tapping-term-ms = <200>;
//     quick-tap-ms = <QUICK_TAP_MS>;
//     bindings = <&mo>, <&spc_morph>;
// )
// SIMPLE_MORPH(spc_morph, SFT, &kp SPACE, &dot_spc)
// ZMK_MACRO(dot_spc,
//     wait-ms = <0>;
//     tap-ms = <5>;
//     bindings = <&kp DOT &kp SPACE &sk LSHFT>;
// )

// tap: backspace | lshft + tap: delete | rshft + tap: shift-delete
// ZMK_MOD_MORPH(bs_del,
//     bindings = <&kp BSPC>, <&kp DEL>;
//     mods = <(MOD_LSFT|MOD_RSFT)>;
//     keep-mods = <MOD_RSFT>;
// )

// tap: copy | double-tap: cut
// ZMK_TAP_DANCE(copy_cut,
//     tapping-term-ms = <200>;
//     bindings = <&kp LC(INS)>, <&kp LC(X)>;
// )

// Sticky shift + leader
// ZMK_MACRO(leader_sft, bindings = <&sk LSHFT &leader>;)

// misc aliases
// #define CANCEL      &kp K_CANCEL             // cancel caps-word, num-word and smart-mouse
// #define DSK_PREV    &hmr LCTRL LG(LC(LEFT))  // previous desktop
// #define DSK_NEXT    &hmr LALT LG(LC(RIGHT))  // next     desktop
// #define PIN_WIN     &kp LG(LC(LS(Q)))        // pin window across desktops
// #define PIN_APP     &kp LG(LC(LS(A)))        // pin application across desktops
// #define DSK_MGR     &kp LA(GRAVE)            // desktop manager
// #define VOL_DOWN    &hmr RSHFT C_VOL_DN

/* Keymap */

// this is how you do combined layer key to new third layer
// ZMK_CONDITIONAL_LAYER(sys, FN NUM, SYS)  // FN + NUM --> SYS

ZMK_LAYER(base,
//╭─────────────┬─────────────┬─────────────┬─────────────┬─────────────╮ ╭─────────────┬─────────────┬─────────────┬─────────────┬─────────────╮
    &kp B         &kp Y         &kp O         &kp U         &kp Z           &kp Q         &kp L         &kp D         &kp W         &kp V        
//├─────────────┼─────────────┼─────────────┼─────────────┼─────────────┤ ├─────────────┼─────────────┼─────────────┼─────────────┼─────────────┤
    &hml LGUI C   &hml LALT I   &hml LSHFT E  &hml LCTRL A  &kp COMMA       &kp DOT       &hmr LCTRL H  &hmr RSHFT T  &hmr LALT S   &hmr LGUI N  
//├─────────────┼─────────────┼─────────────┼─────────────┼─────────────┤ ├─────────────┼─────────────┼─────────────┼─────────────┼─────────────┤
    &kp G         &kp X         &kp J         &kp K         &kp MINUS       &kp FSLH      &kp R         &kp M         &kp F         &kp P        
//╰─────────────┼─────────────┼─────────────┼─────────────┼─────────────┤ ├─────────────┼─────────────┼─────────────┴───────────────────────────╯
                                &mo 1         &kp SPACE       &kp LGUI        SMART_NUM     &smart_shft   &smart_shft  
//                            ╰─────────────┴─────────────┴─────────────╯ ╰─────────────┴─────────────┴─────────────╯                            
)

ZMK_LAYER(nav,
//╭─────────────┬─────────────┬─────────────┬─────────────┬─────────────╮ ╭─────────────┬─────────────┬─────────────┬─────────────┬─────────────╮
    ___           ___           &kp LS(TAB)   &swapper      ___             &kp PG_UP     NAV_BSPC      NAV_UP        NAV_DEL       ___          
//├─────────────┼─────────────┼─────────────┼─────────────┼─────────────┤ ├─────────────┼─────────────┼─────────────┼─────────────┼─────────────┤
    &sk LGUI      &sk LALT      &sk LSHFT     &sk LCTRL     ___             &kp PG_DN     NAV_LEFT      NAV_DOWN      NAV_RIGHT     &kp RET      
//├─────────────┼─────────────┼─────────────┼─────────────┼─────────────┤ ├─────────────┼─────────────┼─────────────┼─────────────┼─────────────┤
    ___           ___           ___           ___           ___             &kp INS       &kp TAB       ___           ___           ___          
//╰─────────────┼─────────────┴─────────────┼─────────────┼─────────────┤ ├─────────────┼─────────────┼─────────────┴───────────────────────────╯
                                ___           ___           ___             ___           CANCEL        CANCEL       
//                            ╰─────────────┴─────────────┴─────────────╯ ╰─────────────┴─────────────┴─────────────╯                            
)

ZMK_LAYER(sys,
//╭─────────────┬─────────────┬─────────────┬─────────────┬─────────────╮ ╭─────────────┬─────────────┬─────────────┬─────────────┬─────────────╮
                               _BT_SEL_KEYS_                                ___           ___           ___           ___           ___          
//├─────────────┼─────────────┼─────────────┼─────────────┼─────────────┤ ├─────────────┼─────────────┼─────────────┼─────────────┼─────────────┤
    ___           ___           ___           ___           &bootloader     &bootloader   ___           ___           ___           ___          
//├─────────────┼─────────────┼─────────────┼─────────────┼─────────────┤ ├─────────────┼─────────────┼─────────────┼─────────────┼─────────────┤
    ___           ___           ___           ___           &sys_reset      &sys_reset    ___           ___           ___           ___          
//╰─────────────┼─────────────┴─────────────┼─────────────┼─────────────┤ ├─────────────┼─────────────┼─────────────┴───────────────────────────╯
                                ___           ___           ___             ___           ___           ___                                      
//                            ╰─────────────┴─────────────┴─────────────╯ ╰─────────────┴─────────────┴─────────────╯                            
)

/* vim: set ft=c tw=174: */

/* use 5-column layout for Zen */
ZMK_APPLY_MATRIX_TRANSFORM(five_column_transform)
